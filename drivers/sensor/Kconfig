## drivers/sensor/Kconfig
```kconfig
# Copyright (c) 2021 Nordic Semiconductor ASA
# SPDX-License-Identifier: Apache-2.0

if SENSOR
rsource "hc_sr04/Kconfig"
endif # SENSOR
```

## drivers/sensor/hc_sr04/Kconfig
```kconfig
# Copyright (c) 2021 Nordic Semiconductor ASA
# SPDX-License-Identifier: Apache-2.0

config HC_SR04
	bool "HC-SR04 Ultrasonic Ranging Module"
	default n
	depends on DT_HAS_ZEPHYR_HC_SR04_ENABLED
	select GPIO
	help
	  Enable HC-SR04 ultrasonic distance sensor.
```

## dts/bindings/sensor/zephyr,hc-sr04.yaml
```yaml
# Copyright (c) 2024 Pierre COURBIN
# Based on https://github.com/inductivekickback/hc-sr04, Copyright (c) 2020 Daniel Veilleux

description: HC-SR04 Ultrasonic Ranging Module

compatible: "zephyr,hc-sr04"

include: base.yaml

properties:
  status:
    required: true
    type: string
    description: Human readable string describing the device's status

  trig-gpios:
    type: phandle-array
    description: Trigger pin
    required: true

  echo-gpios:
    type: phandle-array
    description: Echo pin
    required: true
```
